## conexio_blitz/Kconfig.board
```kconfig
# Conexio BLITZ board configuration

# Copyright (c) 2024 Conexio Technologies, Inc
# SPDX-License-Identifier: Apache-2.0

if SOC_NRF5340_CPUAPP_QKAA

config BOARD_CONEXIO_BLITZ_CPUAPP
	bool "Conexio Blitz Application MCU"

config BOARD_CONEXIO_BLITZ_CPUAPP_NS
	bool "Conexio Blitz Application MCU non-secure"

endif # SOC_NRF5340_CPUAPP_QKAA

if SOC_NRF5340_CPUNET_QKAA

config BOARD_CONEXIO_BLITZ_CPUNET
	bool "Conexio Blitz Network MCU"

endif # SOC_NRF5340_CPUNET_QKAA
```

## conexio_blitz/conexio_blitz_cpuapp_defconfig
```kconfig
# Copyright (c) 2024 Conexio Technologies, Inc
# SPDX-License-Identifier: Apache-2.0

CONFIG_SOC_SERIES_NRF53X=y
CONFIG_SOC_NRF5340_CPUAPP_QKAA=y
CONFIG_BOARD_CONEXIO_BLITZ_CPUAPP=y

# Enable MPU
CONFIG_ARM_MPU=y

# Enable hardware stack protection
CONFIG_HW_STACK_PROTECTION=y

# Enable TrustZone-M
CONFIG_ARM_TRUSTZONE_M=y

# Enable GPIO
CONFIG_GPIO=y

# Enable console
CONFIG_CONSOLE=y
CONFIG_UART_CONSOLE=y

# Enable uart driver
CONFIG_SERIAL=y

CONFIG_PINCTRL=y

# Blitz only has the XTAL oscillator connected to XC1 and XC2
CONFIG_CLOCK_CONTROL_NRF_K32SRC_RC=y

# Board Kconfig.defconfig enables USB CDC ACM and should disable USB remote
# wakeup by default. It needs to be disabled here, because the USB nrfx
# driver always overwrites option from Kconfig mentioned above with the
# imply from CONFIG_USB_NRFX.
CONFIG_USB_DEVICE_REMOTE_WAKEUP=n
```

## conexio_blitz/conexio_blitz_cpunet_defconfig
```kconfig
# Copyright (c) 2024 Conexio Technologies, Inc
# SPDX-License-Identifier: Apache-2.0

CONFIG_SOC_SERIES_NRF53X=y
CONFIG_SOC_NRF5340_CPUNET_QKAA=y
CONFIG_BOARD_CONEXIO_BLITZ_CPUNET=y

# Enable MPU
CONFIG_ARM_MPU=y

# Enable hardware stack protection
CONFIG_HW_STACK_PROTECTION=y

# Enable GPIO
CONFIG_GPIO=y

# Enable pin controller driver
CONFIG_PINCTRL=y

# Blitz only has the 32kHz RC oscillator connected to XC1 and XC2
CONFIG_CLOCK_CONTROL_NRF_K32SRC_RC=y
```
