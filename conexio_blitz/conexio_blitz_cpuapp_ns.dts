/*
 * Copyright (c) 2024 Conexio Technologies, Inc
 * Copyright (c) 2022 Nordic Semiconductor
 *
 * SPDX-License-Identifier: Apache-2.0
 */

/dts-v1/;
#include <nordic/nrf5340_cpuappns_qkaa.dtsi>
#include "conexio_blitz_common.dtsi"

/ {
	model = "Conexio Blitz NRF5340 Application";
	compatible = "conexio,conexio-blitz-cpuapp";

	chosen {
		zephyr,sram = &sram0_ns;
		zephyr,flash = &flash0;
		zephyr,code-partition = &slot0_ns_partition;
	};

	aliases {
		watchdog0 = &wdt0;
	};
};
